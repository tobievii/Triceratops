#include <SPI.h>
#include <Wire.h>
#include <Adafruit_GFX.h>
#include <Adafruit_SSD1306.h>

#include <WiFi.h>

#include <ArduinoJson.h>
#include <PubSubClient.h>

const char* ssid = "devprotowifi";
const char* password = "devprotowifi";
const char* mqttServer = "prototype.dev.iotnxt.io";
const int mqttPort = 1883;


String apikey = "76mpzsbqv4aws5zn8fh14a1j8c96nwcf";
String deviceid = "microRaptor2";

WiFiClient espClient;
PubSubClient client(espClient);

int LED_BUILTIN1 = 2; //LED for ESP32
 
unsigned long lastupdate = 0;
bool led = true;

bool wifi = false;
bool iotnxt = false;
bool pub = false;

//OLED
#define SCREEN_WIDTH 128 // OLED display width, in pixels
#define SCREEN_HEIGHT 48 // OLED display height, in pixels
#define OLED_RESET     0 // Reset pin # (or -1 if sharing Arduino reset pin)
Adafruit_SSD1306 display(SCREEN_WIDTH, SCREEN_HEIGHT, &Wire, OLED_RESET);

// MQTT
void handleMessages(char* topic, byte* payload, unsigned int length) {
  //Serial.println(payload);
  Serial.println("MQTT recv");

  StaticJsonDocument<200> requestDoc;
  DeserializationError error = deserializeJson(requestDoc, payload);
  JsonObject request = requestDoc.as<JsonObject>();

  String jsontemp; 
  serializeJson(request,jsontemp);
  Serial.println("api call:");
  Serial.println(jsontemp);
  Serial.println("-----");

  String display = request["data"]["display"];
  
  Serial.println(display);
  if (display) { log(display); }
  
  if (request["data"]["digitalWrite"]) {
    pinMode(request["data"]["pin"], OUTPUT);
    digitalWrite(request["data"]["pin"], request["data"]["level"]);
  }   
}

void setup() {

// SSD1306_SWITCHCAPVCC = generate display voltage from 3.3V internally
  if(!display.begin(SSD1306_SWITCHCAPVCC, 0x3C)) { // Address 0x3D for 128x64
    Serial.println(F("SSD1306 allocation failed"));
    for(;;); // Don't proceed, loop forever
  }

  display.clearDisplay();
  bootlogo();
  Serial.begin(115200);
  WiFi.begin(ssid, password);
 
  while (WiFi.status() != WL_CONNECTED) {
    delay(500);
    dashboard();    
  }
 
  wifi = true;
  client.setServer(mqttServer, mqttPort);
  client.setCallback(handleMessages);
  
  connectMqtt();
  client.subscribe(apikey.c_str());
}
 
void loop() {
  dashboard();
  digitalWrite(LED_BUILTIN1, led);

  client.loop();

  if (!client.connected()) {
      iotnxt = false;
      connectMqtt();
  }

  if (client.connected()) {
//      dashboard();
  }

  if (millis() - lastupdate > 15000) {
    lastupdate = millis();
    publishUpdate();
    pub = true;
  }
}

void publishUpdate() {
  //Serial.print("publishing!\n");
  String msg = "{\"id\":\""+deviceid+"\",\"data\":{\"button\":false}}";
  client.publish(apikey.c_str(), msg.c_str());
}

void connectMqtt() {
  Serial.print("reconnect");
  String clientId = "ESP8266Client-";
  clientId += String(random(0xffff), HEX);
  String mqttPassword = "key-"+apikey;
    iotnxt = false;
  while (!client.connected()) {
    Serial.println("Connecting to MQTT...");
    if (client.connect("clientid", "api", mqttPassword.c_str() )) {
      Serial.println("connected"); 
      iotnxt = true;
    } else {
      Serial.print("failed with state ");
      Serial.print(client.state());
      delay(2000); 
    }
  }
}

void log(String msg) {
  display.clearDisplay();
  display.setTextSize(1);
  display.setTextColor(WHITE);  
  display.setCursor(32,0);   
  display.println(msg);
  display.display();  
}

const unsigned char myBitmapBattrey[] PROGMEM = {
    0x00, 0x00, // ................
    0x00, 0x00, // ................
    0x7F, 0x00, // .#######........
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    0x00, 0x00, // ................
};

const unsigned char heart[] PROGMEM = {
  0x7F,0x80, // .########.......
  0x8C,0x40, // #...##...#......
  0x80,0x40, // #........#......
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  0x0C,0x00, // ....##..........
};

const unsigned char heartfill[] PROGMEM = {
  0xF3,0xC0, // ####..####......
  0xFF,0xC0, // ##########......
  0xFF,0xC0, // ##########......
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  0x0C,0x00, // ....##..........
};


int getBarsSignal(long rssi){
  int bars;
  
  if (rssi > -55) { 
    bars = 3;
  } else if (rssi < -55 & rssi > -75) {
    bars = 2;
  } else if (rssi < -75 & rssi > -96) {
    bars = 1;
  } else {
    bars = 0;
  }
  return bars;
}

float getLevel(){
  float raw = analogRead(A0);
  int level = map(raw, 140, 227, 0, 100);     // With a 1M5 resistor
  Serial.print("A0 "); Serial.println(raw);
  
  if ( level < 0 ) { level = 0; }
  if ( level > 100 ) { level = 100; }
  Serial.print("Level: "); Serial.println(level);
  return level;
}

void dashboard(void) {
  display.clearDisplay();
  display.drawBitmap(85, 2, myBitmapBattrey, 10, 10, WHITE);
  display.setTextSize(1);
  display.setTextColor(WHITE); 
  int battreylevel = getLevel();
  int battrey = 4;
  if(battreylevel > 50 && battreylevel < 100){
    battrey = 0;
  }else if(battreylevel < 50 && battreylevel > 10){
    battrey = 4;
  }else{
    battrey = 8;
  }
  display.fillRect(85,5,battrey,4,WHITE);  

  display.setCursor(32,20);   
  if (iotnxt) {           
      display.println(F("CONNECTED"));
      
  } else {
      display.println(F("CONNECTING."));
  }

  display.setCursor(32,30);  
  if (wifi) {
      display.println(F("WIFI ON"));
      long rssi = WiFi.RSSI();
      int bars = getBarsSignal(rssi);
      
      Serial.print("RSSI:");
      Serial.println(rssi);
      display.setTextColor(WHITE);
      display.setCursor(0,0);
      for (int b=0; b <= bars; b++) { 
        display.fillRect(64 + (b*5),10 - (b*2),2,b*2,WHITE); 
      }
      
  } else {
      display.println(F("WIFI OFF"));
  }

  display.setCursor(32,40);  
  if (pub) {
      display.println(battreylevel);
      display.drawBitmap(54, 2, heartfill, 10, 8, WHITE);
      pub = false;
  } else {
      display.println(battreylevel);
      display.drawBitmap(54, 2, heart, 10, 8, WHITE);
  }
  
  display.display();
  delay(1000);
}

const unsigned char myBitmap [] PROGMEM = {
  0x00, 0x00, 0x00, 0x00, 0x00, 0x00, 0x00, 0x00, 0x00, 0x00, 0x00, 0x00, 0x00, 0x00, 0x00, 0x00, 
  0x00, 0x00, 0x00, 0x00, 0x00, 0x00, 0x00, 0x00, 0x00, 0x00, 0x00, 0x00, 0x00, 0x00, 0x00, 0x00, 
  0x00, 0x00, 0x00, 0x00, 0x00, 0x00, 0x00, 0x00, 0x00, 0x00, 0x00, 0x00, 0x00, 0x00, 0x00, 0x00, 
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  0x00, 0x00, 0x00, 0x00, 0x00, 0x00, 0x00, 0x00, 0x00, 0x00, 0x00, 0x00, 0x00, 0x00, 0x00, 0x00
};

void bootlogo(void) {
  display.clearDisplay();
  display.drawBitmap(0, 0, myBitmap, 128, 64, WHITE);
  display.display();
  delay(500);
}


