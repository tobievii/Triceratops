/*
  version 0.0.1
*/

#include <SPI.h>
#include <Wire.h>
#include <Adafruit_GFX.h>
#include <Adafruit_SSD1306.h>

#define SCREEN_WIDTH 128 // OLED display width, in pixels
#define SCREEN_HEIGHT 48 // OLED display height, in pixels

// Declaration for an SSD1306 display connected to I2C (SDA, SCL pins)
#define OLED_RESET 0 // Reset pin # (or -1 if sharing Arduino reset pin)

Adafruit_SSD1306 display(SCREEN_WIDTH, SCREEN_HEIGHT, &Wire, OLED_RESET);

int lib_display_line_default = 5;
int lib_display_line = lib_display_line_default; //offset

String lastMsg = "";

void lib_display_init()
{
  // SSD1306_SWITCHCAPVCC = generate display voltage from 3.3V internally
  if (!display.begin(SSD1306_SWITCHCAPVCC, 0x3C))
  { // Address 0x3D for 128x64
    Serial.println(F("SSD1306 allocation failed"));
    for (;;)
      ; // Don't proceed, loop forever
  }

  display.clearDisplay();
  lib_display_showLogo();
}

long lastUpdate = 0;

long count = 0;

long lastDashboardChange = 0;

void lib_display_loop()
{
  if (millis() - lastUpdate > 1000)
  {
    // frames per second (millis per frame)
    count++;
    lib_display_update();
    lastUpdate = millis();
  }
}

void lib_display_update()
{
  lib_display_newFrame();

  //if (millis() < 3000) {
  //first 3 seconds display uuid;
  //lib_display_uuid(lib_id_getuuid(), touch_value);
  //}

  // // number count
  // if ((millis() > 3000)&&(millis()<6000)) {
  //   lib_display_log(String(count) );
  // }

  //lib_display_log("rouan" );

  // status icons
  lib_display_wifi(lib_wifi_status_get());
  lib_display_cloud(lib_mqtt_status_get());

  // dashboards
  if (millis() - lastDashboardChange > 3000)
  {
    lastMsg = lib_state_version();
  }

  if (lastMsg != "")
  {
    lib_display_showLastMsg();
    //lib_display_sensorValues();
    // lib_display_infor(String(getTemp()));
  }

  // lib_display_uuid(lib_id_getuuid());
  //lib_display_uuid("abcdefghijklmnop");

  // //battery
  //lib_display_drawBattery(lib_battery_percentage());

  // //wifi
  // lib_display_drawWifi((count/3) % 4);

  // //heart
  // lib_display_heart((count/12)%2);

  // //warning
  // lib_display_warning();

  // //alarm
  // lib_display_alarm();

  // //cloud
  //
  //lib_display_sensorValues();
  lib_battery_update();

  //Serial.println(lib_battery_lastadc());
  //Serial.println(lib_battery_volts());
  //Serial.println(lib_battery_percentage());

  display.display(); // update display
}

void lib_display_sensorValues()
{
  int y = 7;
  //String header = "";
  //float sensor_value = 0;

  display.setTextSize(0);
  display.setTextColor(WHITE);
  display.setCursor(32, y + lib_display_line);
  display.println(getRadar());
  lib_display_line += 10;
  display.setCursor(32, y + lib_display_line);
  display.println(getUltrasonic2());
}

void lib_display_newFrame()
{
  display.clearDisplay();
  lib_display_line = lib_display_line_default;
}

// rouan: Disabled this for now until we get stuff seperated cleanly.

// void lib_display_infor(String lastHeader)
// {
//   String msg = lastHeader;
//   int y = 7; //text start pixel from top

//   while (msg.length() > 0)
//   {
//     display.setTextSize(0);
//     display.setTextColor(WHITE);
//     lib_display_line += 10;

//     if (getTemp() < 15 || msg == "nan")
//     {
//       lib_display_alarm();
//     }

//     if (getLightSensor() < 1000)
//     {
//       lib_display_warning();
//     }

//     if (getTouch() > 50)
//     {
//       if (getPotentiometer() < 2000)
//       {
//         display.setCursor(32, y + lib_display_line);
//         display.println("TEMP: ");
//         display.setCursor(62, y + lib_display_line);
//         display.println(msg.substring(0, 11));
//         lib_display_line += 10;
//         display.setCursor(32, y + lib_display_line);
//         display.println("HUMI: ");
//         display.setCursor(62, y + lib_display_line);
//         display.println(getHumidity());
//       }
//       else if (lib_sensors_getPotentiometer() > 2000)
//       {
//         display.setCursor(32, y + lib_display_line);
//         display.println("LIGHT:");
//         display.setCursor(70, y + lib_display_line);
//         display.println(lib_sensors_getLightSensor());
//         lib_display_line += 10;
//         display.setCursor(32, y + lib_display_line);
//         display.println(getTime());
//       }
//     }
//     else
//     {
//       display.setCursor(32, y + lib_display_line);
//       display.println("METER:");
//       display.setCursor(70, y + lib_display_line);
//       display.println(lib_sensors_getPotentiometer());
//     }
//     msg = msg.substring(11);
//   }

//   display.display();
// }

void lib_display_log(String msg)
{
  lastMsg = msg;
}

void lib_display_showLastMsg()
{
  String msg = lastMsg;
  int y = 7; //text start pixel from top

  while (msg.length() > 0)
  {
    lib_display_drawBattery(lib_battery_percentage());
    display.setTextSize(0);
    display.setTextColor(WHITE);
    display.setCursor(32, y + lib_display_line);
    display.println(msg.substring(0, 11));
    lib_display_line += 10;
    msg = msg.substring(11);
  }

  display.display();
}

// ----------------------------------------------------------------------------

void lib_display_uuid(String uuid, int touchinput)
{
  int y = 7; //text start pixel from top
  display.setTextSize(1);
  display.setTextColor(WHITE);

  // display.setCursor(32,y+lib_display_line);
  // display.println("UUID:");
  // lib_display_line+=18;

  if (uuid.length() > 8)
  {
    String lineA = uuid.substring(0, 8);
    display.setCursor(32, y + lib_display_line);
    display.println(lineA);
    lib_display_line += 10;

    String lineB = uuid.substring(8, 16);
    display.setCursor(32, y + lib_display_line);
    display.println(lineB);
    lib_display_line += 10;
  }
}

// ----------------------------------------------------------------------------

const unsigned char myBitmap[] PROGMEM = {
    0x00, 0x00, 0x00, 0x00, 0x00, 0x00, 0x00, 0x00, 0x00, 0x00, 0x00, 0x00, 0x00, 0x00, 0x00, 0x00,
    0x00, 0x00, 0x00, 0x00, 0x00, 0x00, 0x00, 0x00, 0x00, 0x00, 0x00, 0x00, 0x00, 0x00, 0x00, 0x00,
    0x00, 0x00, 0x00, 0x00, 0x00, 0x00, 0x00, 0x00, 0x00, 0x00, 0x00, 0x00, 0x00, 0x00, 0x00, 0x00,
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    0x00, 0x00, 0x00, 0x00, 0x00, 0x00, 0x00, 0x00, 0x00, 0x00, 0x00, 0x00, 0x00, 0x00, 0x00, 0x00};

void lib_display_showLogo(void)
{
  display.clearDisplay();
  display.drawBitmap(0, 0, myBitmap, 128, 64, WHITE);
  display.display();
  //delay(500);
}

// ----------------------------------------------------------------------------

const unsigned char bitmap_battery[] PROGMEM = {
    0x7F, 0x00, // .#######........
    0x80, 0x80, // #.......#.......
    0x80, 0xC0, // #.......##......
    0x80, 0xC0, // #.......##......
    0x80, 0x80, // #.......#.......
    0x7F, 0x00, // .#######........
};

void lib_display_drawBattery(int batteryLevel)
{
  float button = analogRead(A0);

  int x = 86;
  int y = 0;
  display.drawBitmap(x, y, bitmap_battery, 10, 6, WHITE);
  display.fillRect(x + 1, y + 1, batteryLevel, 4, WHITE);
}

// ----------------------------------------------------------------------------

void lib_display_drawWifi(int bars)
{
  int x = 75;
  int y = 0;

  //antennah icon
  display.drawCircle(x, 1, 1, WHITE);
  display.fillRect(x, 3, 1, 3, WHITE);

  for (int b = 0; b <= bars; b++)
  {
    display.fillRect(x + 1 + (b * 2), 6 - (b * 2), 1, b * 2, WHITE);
  }
}

// ----------------------------------------------------------------------------

const unsigned char bitmap_heart[] PROGMEM = {
    0x6c, 0x92, 0x82, 0x44, 0x28, 0x10};

const unsigned char bitmap_heartfill[] PROGMEM = {
    0x6c, 0xfe, 0xfe, 0x7c, 0x38, 0x10};

void lib_display_heart(bool pulse)
{
  int x = 49;
  int y = 0;
  if (pulse)
  {
    display.drawBitmap(x, y, bitmap_heartfill, 7, 6, WHITE);
  }
  else
  {
    display.drawBitmap(x, y, bitmap_heart, 7, 6, WHITE);
  }
}

// ----------------------------------------------------------------------------

const unsigned char bitmap_warning[] PROGMEM = {
    0x10, 0x28, 0x28, 0x7c, 0x6c, 0xfe};

void lib_display_warning(void)
{
  int x = 65;
  int y = 0;
  display.drawBitmap(x, y, bitmap_warning, 7, 6, WHITE);
}

// ----------------------------------------------------------------------------

const unsigned char bitmap_alarm[] PROGMEM = {
    0x02, 0x1a, 0xfa, 0xfa, 0x58, 0x42};

void lib_display_alarm(void)
{
  int x = 55;
  int y = 0;
  display.drawBitmap(x, y, bitmap_alarm, 7, 6, WHITE);
}

// ----------------------------------------------------------------------------

const unsigned char bitmap_cloud_outline[] PROGMEM = {
    0x38, 0x00, 0x47, 0x00, 0x80, 0x80, 0x80, 0x80, 0x80, 0x80, 0x7f, 0x00};

const unsigned char bitmap_cloud[] PROGMEM = {
    0x38, 0x00, 0x7e, 0x00, 0xfb, 0x00, 0xd7, 0x80, 0xef, 0x80, 0x7f, 0x00};

const unsigned char bitmap_cloud_none[] PROGMEM = {
    0x38, 0x00, 0x7c, 0x00, 0xd7, 0x00, 0xef, 0x80, 0xd7, 0x80, 0x7f, 0x00};

void lib_display_cloud(int state)
{
  int x = 42;
  int y = 0;

  if (state == 0)
  {
    display.drawBitmap(x, y, bitmap_cloud_outline, 9, 6, WHITE);
    return;
  }

  if (state == 1)
  {
    display.drawBitmap(x, y, bitmap_cloud_outline, 9, 6, WHITE);

    for (int b = 0; b < 2; b++)
    {
      display.drawPixel(x + 2 + (b * 2), 3, WHITE);
    }
  }

  if (state == 2)
  {
    display.drawBitmap(x, y, bitmap_cloud_outline, 9, 6, WHITE);
  }

  if (state == 3)
  {
    // success
    display.drawBitmap(x, y, bitmap_cloud, 9, 6, WHITE);
  }
}

// ----------------------------------------------------------------------------

const unsigned char bitmap_wifi[] PROGMEM = {
    0x7e, 0x81, 0x3c, 0x42, 0x18, 0x18};

// wifi with one circle
const unsigned char bitmap_wifi_half[] PROGMEM = {
    0x00, 0x00, 0x3c, 0x42, 0x18, 0x18};

// wifi dot circle
const unsigned char bitmap_wifi_dotcircle[] PROGMEM = {
    0x00, 0x00, 0x18, 0x24, 0x24, 0x18};

// wifi dot
const unsigned char bitmap_wifi_dot[] PROGMEM = {
    0x00, 0x00, 0x00, 0x00, 0x18, 0x18};

void lib_display_wifi(int state)
{
  int x = 32;
  int y = 0;

  // WL_IDLE_STATUS     // 0
  // WL_NO_SSID_AVAIL   // 1
  // WL_SCAN_COMPLETED  // 2
  // WL_CONNECTED       // 3
  // WL_CONNECT_FAILED  // 4
  // WL_CONNECTION_LOST // 5
  // WL_DISCONNECTED    // 6
  // WL_NO_SHIELD       // 255

  if (state == 0)
  {
    display.drawBitmap(x, y, bitmap_wifi_half, 8, 6, WHITE);
  }

  if (state == 3)
  {
    //connected
    display.drawBitmap(x, y, bitmap_wifi, 8, 6, WHITE);
  }

  if (state == 4)
  {
    display.drawBitmap(x, y, bitmap_wifi_dot, 8, 6, WHITE);
  }

  if (state == 6)
  {
    display.drawBitmap(x, y, bitmap_wifi_dotcircle, 8, 6, WHITE);
  }
}

// ----------------------------------------------------------------------------
